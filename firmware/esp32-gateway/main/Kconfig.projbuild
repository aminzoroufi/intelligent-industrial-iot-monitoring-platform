## firmware/esp32-gateway/main/Kconfig.projbuild
```kconfig
menu "Industrial IoT gateway"

config IIOT_SIMULATION
    bool "Use deterministic Wokwi sensor adapter"
    default n
    help
        Keeps production register drivers in the build while selecting a
        deterministic, explicitly simulated data source at runtime.

config IIOT_SERIAL_PROVISIONING
    bool "Enable time-limited serial provisioning"
    default y

endmenu
```

## firmware/esp32-gateway/sdkconfig.defaults
```kconfig
# ESP-IDF v6.0.2 baseline for ESP32-DevKitC V4.
CONFIG_IDF_TARGET="esp32"
CONFIG_PARTITION_TABLE_CUSTOM=y
CONFIG_PARTITION_TABLE_CUSTOM_FILENAME="partitions.csv"
CONFIG_ESP_TASK_WDT_EN=y
CONFIG_ESP_TASK_WDT_INIT=y
CONFIG_ESP_TASK_WDT_TIMEOUT_S=8
CONFIG_ESP_TASK_WDT_CHECK_IDLE_TASK_CPU0=y
CONFIG_ESP_TASK_WDT_CHECK_IDLE_TASK_CPU1=y
CONFIG_ESP_BROWNOUT_DET=y
CONFIG_ESP_BROWNOUT_DET_LVL_SEL_0=y
CONFIG_LOG_COLORS=n
CONFIG_LOG_TIMESTAMP_SOURCE_RTOS=y
CONFIG_COMPILER_OPTIMIZATION_PERF=y
CONFIG_FREERTOS_HZ=1000
```
